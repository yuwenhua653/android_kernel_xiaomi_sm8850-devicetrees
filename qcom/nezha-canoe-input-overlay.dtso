// SPDX-License-Identifier: GPL-2.0-only
/dts-v1/;
/plugin/;

/ {
	model = "Qualcomm Technologies, Inc. Nezha based on SM8850";
	compatible = "qcom,canoe-mtp", "qcom,canoe", "qcom,canoep-mtp", "qcom,canoep", "qcom,mtp";
	qcom,msm-id = <661 0x20000 660 0x10000 660 0x20000 0x1000294 0x10000>,
		<661 0x10000 0x1000295 0x10000 0x1000294 0x20000 0x1000295 0x20000>;
	qcom,board-id = <8 0>;
	xiaomi,miboard-id = <5 0>;
};

#include "nezha-sm8850-touch.dtsi"
#include "nezha-sm8850-fingerprint.dtsi"
#include "nezha-sm8850-focus-ring.dtsi"
#include "nezha-sm8850-nfc.dtsi"
