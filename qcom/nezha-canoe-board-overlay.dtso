// SPDX-License-Identifier: GPL-2.0-only
/* Use the same board identifiers and input wiring as the Canoe input target. */
#include "nezha-canoe-input-overlay.dtso"
#include "nezha-platform.dtsi"
#include "display/display/nezha-sde-display.dtsi"
#include "nezha-sm8850-regulator.dtsi"
#include "nezha-charger-common.dtsi"

#include "nezha-sm8850-dxs702.dtsi"
#include "nezha-sm8850-tof.dtsi"
#include "nezha-canoe-connectivity.dtsi"
#include <dt-bindings/clock/qcom,gcc-canoe.h>
#include <dt-bindings/clock/qcom,camcc-canoe.h>
#include <dt-bindings/interconnect/qcom,canoe.h>
#include <dt-bindings/interrupt-controller/arm-gic.h>
#include <dt-bindings/regulator/qcom,rpmh-regulator-levels.h>
#include "camera/canoe-camera.dtsi"
#include "nezha-canoe-camera.dtsi"

#include "nezha-canoe-audio.dtsi"
