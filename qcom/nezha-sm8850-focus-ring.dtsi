// SPDX-License-Identifier: GPL-2.0-only
// Xiaomi 17 Ultra (nezha), OS4.0.7.0.XPACNXM board wiring.

&soc {
	qcom,smp2p-adsp {
		focus_ring_smp2p_in: qcom,focus-ring-in {
			qcom,entry-name = "mi_focus_ring";
			interrupt-controller;
			#interrupt-cells = <2>;
		};
	};

	xiaomi_focus_ring {
		compatible = "xiaomi-focus-ring";
		status = "ok";
		interrupts-extended = <&focus_ring_smp2p_in 0 0>,
			<&focus_ring_smp2p_in 1 0>,
			<&focus_ring_smp2p_in 2 0>,
			<&focus_ring_smp2p_in 3 0>,
			<&focus_ring_smp2p_in 4 0>,
			<&focus_ring_smp2p_in 5 0>,
			<&focus_ring_smp2p_in 6 0>,
			<&focus_ring_smp2p_in 7 0>,
			<&focus_ring_smp2p_in 8 0>;
		interrupt-names = "add_one_irq", "add_two_irq", "add_three_irq", "sub_one_irq", "sub_two_irq", "sub_three_irq", "rotation_irq", "motion_ping_irq", "motion_pang_irq";
	};
};
