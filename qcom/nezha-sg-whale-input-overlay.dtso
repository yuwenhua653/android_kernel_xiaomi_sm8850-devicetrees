// SPDX-License-Identifier: GPL-2.0-only
/dts-v1/;
/plugin/;

/ {
	model = "Qualcomm Technologies, Inc. Nezha based on SM8850";
	compatible = "qcom,canoe-mtp", "qcom,canoe", "qcom,canoep-mtp", "qcom,canoep", "qcom,mtp";
	qcom,msm-id = <723 0x30000 722 0x30000 743 0x20000 743 0x10000>;
	qcom,board-id = <8 0>;
	xiaomi,miboard-id = <5 0>;
};

#include "nezha-sm8850-touch.dtsi"
#include "nezha-sm8850-fingerprint.dtsi"
#include "nezha-sm8850-focus-ring.dtsi"
#include "nezha-sm8850-nfc.dtsi"
