// SPDX-License-Identifier: GPL-2.0-only
/* MiCode kernel_devicetree 396596c6, common and Nezha charger data.
 * Voltage setpoints follow both OS4.0.7.0.XPACNXM factory DTBO entries.
 * The strategy binds when its full charging policy is selected.
 */
&soc {
	mca_buckchg_jeita {
		compatible = "mca,buckchg_jeita";
		vbat_high_hyst = <50>;
		vbat_low_hyst = <50>;
		vterm_buffer = <30>;
		vbat_low_cold_hyst = <50>;
		support_weak_chg_vterm = <1>;
		weak_chg_vterm_cfg = <10 200>;
		volt_para1 =
			"4200", "670",
			"4500", "450";
		volt_para2 =
			"4200", "900",
			"4500", "670";
		volt_para3 =
			"4200", "1350",
			"4500", "900";
		jeita_para =
			"-65535", "-10", "0", "2", "0", "4490", "66", "null",
			"-10", "-2", "0", "2", "262", "4490", "66", "para_n10_n2",
			"-2", "3", "0", "2", "524", "4490", "131", "para_n2_3",
			"3", "8", "0", "2", "787", "4500", "328", "para_3_8",
			"8", "13", "0", "1", "1968", "4500", "328", "para_8_13",
			"13", "15", "0", "1", "3936", "4500", "328", "para_13_15",
			"15", "18", "0", "2", "4000", "4500", "328", "para_15_18",
			"18", "35", "0", "0", "4000", "4480", "328", "null",
			"35", "40", "1", "0", "4000", "4470", "328", "null",
			"40", "48", "1", "0", "4000", "4460", "328", "null",
			"48", "55", "2", "0", "3280", "4060", "328", "null",
			"55", "65535", "2", "2", "0", "4060", "328", "null";
		status = "disabled";
		has-global-batt-para;
		has-second-batt-para;
		para_n10_n2 =
			"4000", "262",
			"4490", "131";
		para_n2_3 =
			"4000", "524",
			"4490", "328";
		para_3_8 =
			"4000", "787",
			"4200", "656",
			"4500", "524";
		para_8_13 =
			"3900", "1968",
			"4500", "1312";
		para_13_15 =
			"3900", "3936",
			"4500", "2624";
		para_15_18 =
			"4150", "4000",
			"4500", "2624";
		jeita_para_ffc =
			"18", "23", "0", "1", "4000", "4530", "722", "null",
			"23", "25", "0", "1", "4000", "4530", "787", "null",
			"25", "35", "0", "0", "4000", "4530", "918", "null",
			"35", "40", "1", "0", "4000", "4530", "1509", "null",
			"40", "48", "1", "0", "4000", "4530", "2230", "null",
			"48", "55", "2", "0", "3280", "4060", "328", "null",
			"55", "65535", "2", "2", "0", "4060", "328", "null";
		xiaomi,cell-supply = <&nezha_fuel_gauge>;
	};

	mca_buckchg_jeita_second_para {
		volt_para1 =
			"4200", "670",
			"4500", "450";
		volt_para2 =
			"4200", "900",
			"4500", "670";
		volt_para3 =
			"4200", "1350",
			"4500", "900";
		jeita_para =
			"-65535", "-10", "0", "2", "0", "4500", "66", "null",
			"-10", "-2", "0", "2", "262", "4500", "66", "para_n10_n2",
			"-2", "3", "0", "2", "524", "4500", "131", "para_n2_3",
			"3", "8", "0", "2", "787", "4510", "328", "para_3_8",
			"8", "13", "0", "1", "1968", "4510", "328", "para_8_13",
			"13", "15", "0", "1", "3936", "4510", "328", "para_13_15",
			"15", "18", "0", "2", "4000", "4510", "328", "para_15_18",
			"18", "35", "0", "0", "4000", "4490", "328", "null",
			"35", "40", "1", "0", "4000", "4480", "328", "null",
			"40", "48", "1", "0", "4000", "4470", "328", "null",
			"48", "55", "2", "0", "3280", "4060", "328", "null",
			"55", "65535", "2", "2", "0", "4060", "328", "null";
		para_n10_n2 =
			"4000", "262",
			"4500", "131";
		para_n2_3 =
			"4000", "524",
			"4500", "328";
		para_3_8 =
			"4000", "787",
			"4200", "656",
			"4510", "524";
		para_8_13 =
			"3900", "1968",
			"4510", "1312";
		para_13_15 =
			"3900", "3936",
			"4510", "2624";
		para_15_18 =
			"4150", "4000",
			"4510", "2624";
		jeita_para_ffc =
			"18", "23", "0", "1", "4000", "4540", "656", "null",
			"23", "25", "0", "1", "4000", "4540", "722", "null",
			"25", "35", "0", "0", "4000", "4540", "788", "null",
			"35", "40", "1", "0", "4000", "4540", "1181", "null",
			"40", "48", "1", "0", "4000", "4540", "1772", "null",
			"48", "55", "2", "0", "3280", "4060", "328", "null",
			"55", "65535", "2", "2", "0", "4060", "328", "null";
	};

	mca_buckchg_jeita_gbl_para {
		support_weak_chg_vterm = <1>;
		weak_chg_vterm_cfg = <10 200>;
		volt_para1 =
			"4200", "670",
			"4500", "450";
		volt_para2 =
			"4200", "900",
			"4500", "670";
		volt_para3 =
			"4200", "1350",
			"4500", "900";
		jeita_para =
			"-65535", "-10", "0", "2", "0", "4530", "293", "null",
			"-10", "3", "0", "2", "300", "4530", "293", "para_n10_3",
			"3", "8", "0", "2", "877", "4540", "468", "para_3_8",
			"8", "13", "0", "1", "1700", "4540", "468", "para_8_13",
			"13", "15", "0", "1", "3510", "4540", "468", "para_13_15",
			"15", "18", "0", "2", "4000", "4540", "468", "para_15_18",
			"18", "35", "0", "0", "4000", "4520", "468", "null",
			"35", "40", "1", "0", "4000", "4500", "468", "null",
			"40", "48", "1", "0", "4000", "4490", "468", "null",
			"48", "55", "2", "0", "2850", "4060", "468", "null",
			"55", "65535", "2", "2", "0", "4060", "468", "null";
		para_n10_3 =
			"4530", "300";
		para_3_8 =
			"4200", "877",
			"4540", "585";
		para_8_13 =
			"4200", "1700",
			"4540", "1170";
		para_13_15 =
			"4200", "3510",
			"4540", "2340";
		para_15_18 =
			"4150", "4000",
			"4540", "2340";
		jeita_para_ffc =
			"18", "23", "0", "1", "4000", "4570", "994", "null",
			"23", "35", "0", "0", "4000", "4570", "1522", "null",
			"35", "40", "1", "0", "4000", "4570", "2574", "null",
			"40", "48", "1", "0", "4000", "4570", "3978", "null",
			"48", "55", "2", "0", "2850", "4060", "468", "null",
			"55", "65535", "2", "2", "0", "4060", "468", "null";
	};
};
